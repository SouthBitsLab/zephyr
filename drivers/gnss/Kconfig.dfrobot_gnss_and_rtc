## drivers/gnss/Kconfig.dfrobot_gnss_and_rtc
```kconfig
# Copyright 2025 SouthBitsLab
# SPDX-License-Identifier: Apache-2.0

config GNSS_DFROBOT_GNSS_AND_RTC
	bool "DFRobot GNSSAndRTC GNSS-only driver"
	default y
	depends on GNSS
	depends on DT_HAS_DFROBOT_GNSS_AND_RTC_ENABLED
	depends on GNSS_REFERENCE_FRAME_WGS84
	select I2C
	help
	  Enable the GNSS-only driver for the DFRobot Gravity GNSSAndRTC module.
	  The driver reads parsed L76K GNSS data over I2C and publishes it through
	  the Zephyr GNSS subsystem. The RTC portion of the module is not used.
```

## drivers/sensor/tdk/icg20660l/Kconfig
```kconfig
# ICG20660L 6-Axis Motion Tracking device configuration options

# Copyright (c) 2024 TDK Invensense
# SPDX-License-Identifier: Apache-2.0

menuconfig ICG20660L
	bool "ICG20660L 6-Axis Motion Tracking Device"
	default y
	depends on DT_HAS_INVENSENSE_ICG20660L_ENABLED
	select I2C
	help
	  Enable driver for ICG20660L I2C-based six-axis motion tracking device.

if ICG20660L

choice ICG20660L_TRIGGER_MODE
	prompt "Trigger mode"
	default ICG20660L_TRIGGER_GLOBAL_THREAD
	help
	  Specify the type of triggering to be used by the driver.

config ICG20660L_TRIGGER_NONE
	bool "No trigger"

config ICG20660L_TRIGGER_GLOBAL_THREAD
	bool "Use global thread"
	depends on GPIO
	depends on $(dt_compat_any_has_prop,$(DT_COMPAT_INVENSENSE_ICG20660L),int-gpios)
	select ICG20660L_TRIGGER

config ICG20660L_TRIGGER_OWN_THREAD
	bool "Use own thread"
	depends on GPIO
	depends on $(dt_compat_any_has_prop,$(DT_COMPAT_INVENSENSE_ICG20660L),int-gpios)
	select ICG20660L_TRIGGER

endchoice

config ICG20660L_TRIGGER
	bool

config ICG20660L_THREAD_PRIORITY
	int "Thread priority"
	depends on ICG20660L_TRIGGER_OWN_THREAD
	default 10
	help
	  Priority of thread used by the driver to handle interrupts.

config ICG20660L_THREAD_STACK_SIZE
	int "Thread stack size"
	depends on ICG20660L_TRIGGER_OWN_THREAD
	default 1024
	help
	  Stack size of thread used by the driver to handle interrupts.

endif # ICG20660L
```

## dts/bindings/gnss/dfrobot,gnss-and-rtc.yaml
```yaml
# Copyright 2025 SouthBitsLab
# SPDX-License-Identifier: Apache-2.0

description: |
  DFRobot Gravity GNSSAndRTC module (GNSS-only).

  This binding exposes the L76K GNSS data produced by the onboard MCU over I2C.
  The RTC portion of the module is not used by this driver.

  Example configuration:

  &i2c1 {
          clock-frequency = <I2C_BITRATE_FAST>;

          gnss: gnss-and-rtc@66 {
                  compatible = "dfrobot,gnss-and-rtc";
                  reg = <0x66>;
                  gnss-mode = <7>;
                  poll-interval-ms = <1000>;
          };
  };

compatible: "dfrobot,gnss-and-rtc"

include:
  - i2c-device.yaml

properties:
  gnss-mode:
    type: int
    default: 7
    enum:
      - 1  # GPS
      - 2  # BeiDou
      - 3  # GPS + BeiDou
      - 4  # GLONASS
      - 5  # GPS + GLONASS
      - 6  # BeiDou + GLONASS
      - 7  # GPS + BeiDou + GLONASS
    description: |
      GNSS constellation mode written to REG_GNSS_MODE.

  poll-interval-ms:
    type: int
    default: 1000
    description: |
      Interval in milliseconds between polling the module's parsed GNSS registers.
```

## dts/bindings/sensor/invensense,icg20660l-i2c.yaml
```yaml
# Copyright (c) 2024 TDK Invensense
# SPDX-License-Identifier: Apache-2.0

description: ICG20660L 6-Axis IMU accessed through I2C bus

compatible: "invensense,icg20660l"

include: [i2c-device.yaml, "invensense,icg20660l.yaml"]
```

## dts/bindings/sensor/invensense,icg20660l-spi.yaml
```yaml
# Copyright (c) 2024 TDK Invensense
# SPDX-License-Identifier: Apache-2.0

description: ICG20660L 6-Axis IMU accessed through SPI bus

compatible: "invensense,icg20660l"

include: [spi-device.yaml, "invensense,icg20660l.yaml"]
```

## dts/bindings/sensor/invensense,icg20660l.yaml
```yaml
# Copyright (c) 2021 TDK Invensense
# SPDX-License-Identifier: Apache-2.0

description: ICG20660L 6-Axis IMU

compatible: "invensense,icg20660l"

include: sensor-device.yaml

properties:
  reg:
    required: true
    description: I2C address

  int-gpios:
    type: phandle-array
    description: |
      GPIO pin for data ready interrupt. The pin should be configured
      as active high.

  odr:
    type: int
    default: 100
    description: |
      Output data rate in Hz for both accelerometer and gyroscope.
      The value is rounded to the nearest rate achievable by the 8-bit
      SMPLRT_DIV divider: 1000/n Hz where n = 1..256 (1000 Hz down to ~3.91 Hz).

  accel-fs:
    type: int
    default: 0
    enum:
      - 0  # 2g
      - 8  # 4g
      - 16 # 8g
      - 24 # 16g
    description: Accelerometer full scale in g

  gyro-fs:
    type: int
    default: 0
    enum:
      - 0  # ±125 dps
      - 8  # ±250 dps
      - 16 # ±500 dps
    description: |
      Gyroscope full-scale selection. These are raw register values written to
      GYRO_CONFIG[4:3] (i.e., FS_SEL << 3). 0 selects ±125 dps, 8 selects
      ±250 dps, and 16 selects ±500 dps.
```
